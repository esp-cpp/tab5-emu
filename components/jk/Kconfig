## components/jk/Kconfig
```kconfig
menu "Jedi Knight (OpenJKDF2)"

    config JK_ENGINE
        bool "Build the OpenJKDF2 engine"
        default y
        help
            Compile and link the OpenJKDF2 engine (components/jk/OpenJKDF2).
            When disabled the Jedi Knight cart shows an animated test pattern,
            which is useful to bring up the video / input / audio paths.

    config JK_INTERNAL_WIDTH
        int "Internal render width"
        default 320
        help
            Width of the 8-bit frame the engine renders the world into. It is
            scaled to the screen by the PPA.

    config JK_INTERNAL_HEIGHT
        int "Internal render height"
        default 240

    config JK_MENU_WIDTH
        int "Menu buffer width"
        default 640
        help
            The 2D GUI is laid out for 640x480; keep it unless the GUI code is
            changed (JKGUI_SMOL_SCREEN halves it to 320x240 on the DSi).

    config JK_MENU_HEIGHT
        int "Menu buffer height"
        default 480

    config JK_AUDIO_SAMPLE_RATE
        int "Audio mixer sample rate"
        default 22050

endmenu
```

## components/mgs/Kconfig
```kconfig
menu "Metal Gear Solid (mgs_reversing + psyz)"

    config MGS_ENGINE
        bool "Build the Metal Gear Solid native port"
        default y
        help
            Compile the decompiled game (components/mgs/mgs_reversing) against
            psyz's PlayStation SDK reimplementation and software GPU, with the
            Tab5 platform layer in components/mgs/src.

    config MGS_START_STAGE
        string "Stage to boot into"
        default "title"
        help
            "title" runs the real boot chain (title screen, opening cutscene,
            then the dock), as retail does. To jump straight into a stage:
            s00a is the dock, s01a the heliport, s02a the tank hangar; any name
            in port/stage_union.c's Mgs_PlayableStages works (a demo stage,
            dXXX, plays its cutscene).

    config MGS_REPLAY_BENCH
        bool "Frame recorder and replay benchmark (development)"
        default n
        help
            Keep the last frames' GPU batches (768 KB of PSRAM, a copy per
            frame); the pause menu writes them with the VRAM dump, and the
            next cart start replays them pixel for pixel under each
            rasterizer optimisation and times them. Off for play.

endmenu
```

## components/tpm/Kconfig
```kconfig
menu "Star Wars Episode I: The Phantom Menace (tpm-decomp)"

    config TPM_ENGINE
        bool "Build the decompiled game (not runnable yet)"
        default n
        help
            Compile the decompiled C from tpm-decomp against psyz. Off until
            enough of the game is decompiled to run; with it off the cart
            shows the game's load screens from the SD card (the data and
            display path).

    config TPM_SLIDE_SECONDS
        int "Seconds per load screen in the data viewer"
        default 4

endmenu
```

## main/Kconfig.projbuild
```kconfig
menu "tab5-emu"

    config TAB5_EMU_AUTOSTART_DELAY_MS
        int "Auto-start the first game after this many ms (0 = off)"
        default 0
        help
            Bring-up aid: launch the first entry of metadata.csv automatically
            a little after boot, as if Play had been pressed.

    config TAB5_EMU_AUTOSTART_MATCH
        string "Auto-start the first game whose name or path contains this"
        default ""
        depends on TAB5_EMU_AUTOSTART_DELAY_MS > 0
        help
            Empty: the first entry of metadata.csv. A comma-separated list
            launches each in turn when TAB5_EMU_AUTOQUIT_SECONDS is set.

    config TAB5_EMU_AUTOQUIT_SECONDS
        int "Test: quit each auto-started game after this many seconds (0 = off)"
        default 0
        depends on TAB5_EMU_AUTOSTART_DELAY_MS > 0
        help
            Quits the way the pause menu's Quit does, then auto-starts the
            next game of TAB5_EMU_AUTOSTART_MATCH, round and round: a soak
            test of launching and quitting the carts one after another.

    config TAB5_EMU_USB_MSC_AT_BOOT
        bool "Test: turn the USB drive on right after boot"
        default n
        help
            Development aid: enable USB mass storage (the SD card as a USB
            drive) as soon as the GUI is up, without touching the screen.

    config TAB5_EMU_GBA_CPU_IRAM
        bool "GBA: ARM interpreter loop in internal RAM (74 KB)"
        default n
        help
            Places gpSP's execute_arm() in internal RAM instead of running
            it from PSRAM-XIP (see components/gba/linker.lf). Needs
            CONFIG_ESP_SYSTEM_MEMPROT=n (the code lives in the data region)
            and CONFIG_CACHE_L2_CACHE_128KB for the room.

endmenu
```
